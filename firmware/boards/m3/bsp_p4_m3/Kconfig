## firmware/boards/m3/bsp_p4_m3/Kconfig
```kconfig
menu "Pajoniiir JC-ESP32P4-M3 BSP"

config BSP_PCM5102A_MAIN_OUT
    bool "Enable PCM5102A main I2S output"
    default y
    help
        Enable the I2S TX channel for the external PCM5102A MAIN OUT DAC.

config BSP_ES8311_MONITOR
    bool "Enable ES8311 onboard monitor codec"
    default n
    help
        Bring up the ES8311 codec on I2S unit 0 for the onboard monitor
        speaker/headphones path.

endmenu
```

## firmware/common/firmware_health/Kconfig
```kconfig
menu "DDJ firmware health"

config DDJ_OTA_FORCE_ROLLBACK_TEST
    bool "Build an intentionally non-confirming OTA rollback test image"
    default n
    help
        Test-only fault injection. When an OTA image first boots in
        PENDING_VERIFY state, restart before marking it valid so the ESP-IDF
        bootloader must roll back to the prior valid slot. Keep this disabled
        for every production and packaged release image.

config DDJ_OTA_STARTUP_TIMEOUT_TEST
    bool "Hold pending P4 startup readiness false until its deadline"
    default n
    depends on !DDJ_OTA_FORCE_ROLLBACK_TEST
    help
        Test-only fault injection for the JC4880 pending-image startup gate.
        Keep network readiness false for the gate while leaving the real AP
        and API available for observation. The normal 60-second deadline must
        reject the pending image. Keep disabled for all ordinary release builds.

endmenu
```

## firmware/control-board-s3/components/control_link/Kconfig
```kconfig
menu "S3 control link"

config CONTROL_LINK_UART_TX_GPIO
    int "S3 control-link UART TX GPIO"
    default 5
    range 0 48
    help
        ESP32-S3 GPIO used for the UART signal from S3 to P4. The Seeed Studio
        XIAO ESP32S3 migration default is GPIO5 / D4 / SDA because GPIO12 is
        not exposed on this board.

config CONTROL_LINK_UART_RX_GPIO
    int "S3 control-link UART RX GPIO"
    default 6
    range 0 48
    help
        ESP32-S3 GPIO used for the UART signal from P4 to S3. The Seeed Studio
        XIAO ESP32S3 migration default is GPIO6 / D5 / SCL because GPIO13 is
        not exposed on this board.

endmenu
```

## firmware/control-board-s3/components/flx4_midi_host/Kconfig
```kconfig
menu "DDJ-FLX4 MIDI Host"

config DDJ_FLX4_TRANSLATE_TO_P4
    bool "Translate DDJ-FLX4 USB MIDI to P4 control-link frames"
    default n
    help
        Enables the S3 USB host translator path. Keep this disabled until
        raw MIDI capture from the physical DDJ-FLX4 has confirmed the mapping.

config DDJ_FLX4_DUMP_USB_CONFIG_DESCRIPTOR
    bool "Dump DDJ-FLX4 active USB configuration descriptor"
    default n
    help
        Logs the raw active USB configuration descriptor in deterministic
        16-byte hex rows during FLX4 attach. Enable only for USB Audio
        descriptor capture because the output is intentionally verbose.

endmenu
```

## firmware/control-board-s3/components/flx4_usb_audio/Kconfig
```kconfig
menu "DDJ-FLX4 USB Audio"

config DDJ_FLX4_USB_AUDIO_HEADPHONES
    bool "Enable DDJ-FLX4 USB Audio headphones streamer"
    default n
    depends on DDJ_FLX4_HOST_MODE
    help
        Enables the experimental USB Audio Class playback path for routing the
        P4 monitor/headphones mix to the physical DDJ-FLX4 headphones output.
        Keep disabled until tone smoke and end-to-end smoke are accepted.

config DDJ_FLX4_USB_AUDIO_TONE_ON_CHANNELS_1_2
    bool "Route FLX4 USB audio tone to channels 1/2 instead of headphone candidate channels"
    default n
    depends on DDJ_FLX4_USB_AUDIO_HEADPHONES
    help
        Diagnostic channel-mapping switch for tone smoke. Default keeps
        channels 1/2 silent and routes the synthetic tone to channels 3/4 when
        the selected FLX4 playback format is four-channel.

config DDJ_FLX4_USB_AUDIO_TONE_SMOKE_AUTOSTART
    bool "Auto-start FLX4 USB Audio synthetic tone after configure"
    default n
    depends on DDJ_FLX4_USB_AUDIO_HEADPHONES
    help
        Starts the 1 kHz synthetic tone immediately after the FLX4 USB Audio
        playback interface is configured. Use only for the hardware tone smoke
        pass because it continuously submits isochronous OUT transfers.

endmenu
```

## firmware/control-board-s3/components/p4_audio_link/Kconfig
```kconfig
menu "P4 audio link"

config P4_AUDIO_LINK_ENABLED
    bool "Enable P4-to-S3 monitor PCM link receiver"
    default n
    help
        Enables the dedicated P4-to-S3 monitor PCM receiver used by the FLX4
        USB Audio headphones path: an I2S slave RX that deframes P4HP blocks
        into the frame ring. The Seeed Studio XIAO ESP32S3 migration defaults
        to GPIO7/GPIO8/GPIO9 because GPIO10 is not exposed on that board. These
        pins are dedicated to this link in the DDJ-FLX4 product firmware.

config P4_AUDIO_LINK_BCLK_GPIO
    int "P4 audio link I2S BCLK input GPIO"
    default 7
    depends on P4_AUDIO_LINK_ENABLED

config P4_AUDIO_LINK_WS_GPIO
    int "P4 audio link I2S WS/LRCK input GPIO"
    default 8
    depends on P4_AUDIO_LINK_ENABLED

config P4_AUDIO_LINK_DIN_GPIO
    int "P4 audio link I2S DIN GPIO"
    default 9
    depends on P4_AUDIO_LINK_ENABLED

config P4_AUDIO_LINK_BENCH_CONSUMER
    bool "Drain the P4 audio link ring at bench pace"
    default n
    depends on P4_AUDIO_LINK_ENABLED
    help
        Bench-only consumer that keeps the frame ring near half fill so a
        healthy link reports zero overruns and underruns. The product path
        replaces this with the FLX4 USB Audio packet consumer.

endmenu
```

## firmware/control-board-s3/components/s3_debug_ap/Kconfig
```kconfig
menu "S3 Debug AP"

config S3_DEBUG_AP_ENABLED
    bool "Build runtime S3 debug AP support"
    default y
    help
        Builds the runtime-controlled S3 debug AP and live log viewer. Runtime
        state remains OFF until P4 sends CTRL_ID_S3_DEBUG_AP ON.

config S3_DEBUG_AP_MAX_CLIENTS
    int "Maximum SoftAP clients"
    default 1
    range 1 4
    depends on S3_DEBUG_AP_ENABLED

endmenu
```

## firmware/control-board-s3/components/wifi_debug_log/Kconfig
```kconfig
menu "Wi-Fi debug log"

config WIFI_DEBUG_LOG_ENABLED
    bool "Enable Wi-Fi UDP debug log"
    default n
    help
        Sends ESP logs over best-effort UDP in addition to the normal UART
        console. Keep disabled for production builds.

config WIFI_DEBUG_LOG_SSID
    string "Wi-Fi debug log SSID"
    default ""
    depends on WIFI_DEBUG_LOG_ENABLED
    help
        Development Wi-Fi SSID. Put real local credentials in ignored sdkconfig,
        not in versioned defaults.

config WIFI_DEBUG_LOG_PASSWORD
    string "Wi-Fi debug log password"
    default ""
    depends on WIFI_DEBUG_LOG_ENABLED
    help
        Development Wi-Fi password. Do not commit real passwords.

config WIFI_DEBUG_LOG_HOST
    string "Wi-Fi debug log UDP host IPv4"
    default ""
    depends on WIFI_DEBUG_LOG_ENABLED
    help
        PC IPv4 address running the UDP listener.

config WIFI_DEBUG_LOG_PORT
    int "Wi-Fi debug log UDP port"
    default 3333
    range 1 65535
    depends on WIFI_DEBUG_LOG_ENABLED

endmenu
```

## firmware/main-deck-p4/components/audio_engine/Kconfig
```kconfig
menu "Audio engine"

config AUDIO_SCRATCH_ENABLED
    bool "Enable vinyl/scratch mode (jog platter scratches the audio)"
    default n
    help
        When enabled, touching the FLX4 jog platter top while a deck plays
        scratches the audio (forward + reverse) by driving a read head over the
        per-deck PSRAM scratch capture buffer, instead of the Phase 1 platter
        hold+scrub. Releasing seeks normal forward playback to the head position.
        Additive: with this off the output path is unchanged and touching the
        platter does the Phase 1 hold/scrub. See docs/VINYL_SCRATCH_PLAN.md.

config AUDIO_PCM_TIMELINE_QUALIFICATION
    bool "Run one-shot PCM timeline hardware qualification"
    default n
    help
        Test-build-only gate. On boot, run 100 forced low-word wrap and
        playhead handoff repetitions with a higher-priority same-core reader,
        then measure both unhooked publications for 100 repetitions. The
        result is written as TIMELINE_QUALIFICATION in the service journal.
        Keep this disabled in production and release-candidate images.

endmenu
```

## firmware/main-deck-p4/components/audio_recorder/Kconfig
```kconfig
menu "Audio Recorder (P4 master output)"

config AUDIO_RECORDER_ENABLED
    bool "Enable the master-output microSD recorder"
    default n
    help
        Records the post-limiter MAIN block to a WAV on the microSD card.

        Off by default. Producer/STOP ownership, finalize error propagation and
        `.part` publication safety are host-tested, but release enablement still
        requires physical SD write/fsync/rename and power-loss fault injection.
        Its write latency is dominated by the microSD card: a card that stalls for
        hundreds of milliseconds at a time drains the ring no matter how the
        writer is arranged, and chasing that consumed a great deal of bench time
        for something that is not on the critical path. See the recorder entries
        in docs/bench-notes.md before turning it back on - the firmware-side
        contributions were already eliminated, so the next step is card
        selection, not more code.

        With this off the audio output path does not even test for the
        recorder's state, the Settings RECORD control is not built, and the
        /api/recording endpoints are not registered.

choice AUDIO_RECORDER_RING_SIZE
    depends on AUDIO_RECORDER_ENABLED
    prompt "Master recorder PSRAM ring size"
    default AUDIO_RECORDER_RING_512K
    help
        Size of the preallocated PSRAM ring that buffers rendered master blocks
        between the audio output task and the writer task. A larger ring
        tolerates longer microSD write stalls at the cost of PSRAM. The ring is
        allocated only while recording is active.

    config AUDIO_RECORDER_RING_256K
        bool "256 KiB (~1.4 s @ 48 kHz)"
    config AUDIO_RECORDER_RING_512K
        bool "512 KiB (~2.7 s @ 48 kHz)"
    config AUDIO_RECORDER_RING_1M
        bool "1 MiB (~5.5 s @ 48 kHz)"
endchoice

config AUDIO_RECORDER_RING_BYTES
    int
    default 262144 if AUDIO_RECORDER_RING_256K
    default 524288 if AUDIO_RECORDER_RING_512K
    default 1048576 if AUDIO_RECORDER_RING_1M

config AUDIO_RECORDER_RING_INTERNAL
    bool "Allocate the recorder ring in internal RAM"
    default n
    depends on AUDIO_RECORDER_ENABLED
    help
        Diagnostic. Recording was measured to stall the audio output task for
        170-224 ms at a time, always inside the mixer loop, which holds no locks
        and only reads PCM out of PSRAM. Moving the ring out of PSRAM removes the
        recorder's own PSRAM traffic and tells us whether that traffic is the
        cause.

        Internal RAM is scarce (about 116 KiB free with two tracks loaded), so
        the internal ring is necessarily far smaller than the PSRAM one and
        tolerates a much shorter microSD write stall before dropping blocks.
        Dropped blocks with clean audio timing would still confirm the
        hypothesis. Do not ship this on unless the size below is proven
        sufficient.

config AUDIO_RECORDER_RING_INTERNAL_BYTES
    int "Internal recorder ring size (bytes)"
    default 32768
    depends on AUDIO_RECORDER_RING_INTERNAL
    help
        Keep well under the free internal heap: it is also needed for DMA
        buffers, task stacks and ISRs.

endmenu
```

## firmware/main-deck-p4/components/board_adapter/Kconfig
```kconfig
menu "Pajoniiir board"
config PAJONIIIR_BOARD_JC1060
    bool "JC1060P470C_I_W_Y target"
    default n
endmenu
```

## firmware/main-deck-p4/components/bsp_jc4880/Kconfig
```kconfig
menu "Pajoniiir JC4880 BSP"

config BSP_PCM5102A_MAIN_OUT
    bool "Enable PCM5102A main I2S output"
    default n
    help
        Enable the second I2S TX channel for the external PCM5102A MAIN OUT DAC.
        Keep disabled until GPIO50/GPIO52/GPIO51 are bench-verified on JP1.

config BSP_ES8311_MONITOR
    bool "Enable ES8311 onboard monitor codec"
    default y
    help
        Bring up the ES8311 codec on I2S unit 0 for the onboard monitor
        speaker/headphones path. Disable to free I2S unit 0 for the FLX4 USB
        headphones monitor link (product config: PCM5102A MAIN on unit 1 +
        monitor link on unit 0, cue/monitor delivered over USB to the FLX4).

endmenu
```

## firmware/main-deck-p4/components/controller_profile_manager/Kconfig
```kconfig
menu "Controller Profile Manager"

config CONTROLLER_PROFILE_MANAGER
    bool "Scan SD/TF for controller profiles at boot"
    default y
    help
        Scans CONTROLLER_PROFILE_SD_PATH for compiled S3CP controller
        profiles (see docs/CONTROLLER_PROFILE_SCHEMA.md) and keeps a registry
        used to match a connected controller by VID/PID. Later phases send the
        active profile to the S3 over the control link.

config CONTROLLER_PROFILE_SD_PATH
    string "Profile directory on the SD/TF card"
    default "/sd/controllers"
    depends on CONTROLLER_PROFILE_MANAGER

endmenu
```

## firmware/main-deck-p4/components/library/Kconfig
```kconfig
menu "Media library"

config LIBRARY_ANLZ_CACHE_WRITE
    bool "Write parsed ANLZ metadata cache to microSD"
    default n if PAJONIIIR_P4_LOCAL_CONTROLLER
    default y
    help
        Cache cold USB ANLZ parses on microSD so later loads are faster. Disable
        this on hardware whose supply cannot tolerate the microSD commit current
        peak. Existing cache entries remain readable; only new writes are
        suppressed.

endmenu
```

## firmware/main-deck-p4/components/monitor_pcm_link/Kconfig
```kconfig
menu "Monitor PCM link"

config MONITOR_PCM_LINK_ENABLED
    bool "Enable monitor PCM link transport"
    default n
    help
        Enables the dedicated P4-to-S3 monitor PCM transport: an I2S TX master
        that streams framed P4HP blocks to the S3 p4_audio_link receiver.

config MONITOR_PCM_LINK_BCLK_GPIO
    int "Monitor PCM link I2S BCLK GPIO"
    default 32
    depends on MONITOR_PCM_LINK_ENABLED

config MONITOR_PCM_LINK_WS_GPIO
    int "Monitor PCM link I2S WS/LRCK GPIO"
    default 34
    depends on MONITOR_PCM_LINK_ENABLED

config MONITOR_PCM_LINK_DOUT_GPIO
    int "Monitor PCM link I2S DOUT GPIO"
    default 35
    depends on MONITOR_PCM_LINK_ENABLED

config MONITOR_PCM_LINK_I2S_UNIT
    int "Monitor PCM link I2S unit (0-1)"
    default 1
    range 0 1
    depends on MONITOR_PCM_LINK_ENABLED
    help
        I2S peripheral unit that drives the monitor link. Unit 2 freezes on the
        rev v1.3 (eco2) P4. Use unit 1 for the bench (ES8311 keeps unit 0); use
        unit 0 for the product config (ES8311 disabled, PCM5102A MAIN on unit 1).

config MONITOR_PCM_LINK_BENCH_TONE
    bool "Generate deterministic 1 kHz bench tone through the monitor PCM link"
    default n
    depends on MONITOR_PCM_LINK_ENABLED
    help
        Starts a bench task that enables the link and feeds a deterministic
        1 kHz -18 dBFS stereo sine at 48 kHz. Use only for the P4-to-S3 link
        bench pass; the product path publishes real hp_out blocks instead.

endmenu
```

## firmware/main-deck-p4/components/sd_idle_wait/Kconfig
```kconfig
menu "Pajoniiir storage compatibility"
config PAJONIIIR_SD_IDLE_WAIT
    bool "Experimental yielding SDMMC idle wait (IDF 6.0.2)"
    default n
    help
        One CMD13 per tick instead of a command storm. Keep off in ordinary
        builds until SD latency and audio/USB A/B hardware acceptance passes.
        SPI uses the original implementation. An IDF upgrade requires review.
endmenu
```
