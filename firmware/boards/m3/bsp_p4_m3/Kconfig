## firmware/main-deck-p4/components/ui/Kconfig
```kconfig
menu "Pajoniiir UI migration"
config PAJONIIIR_DJ_OVERVIEW
    bool "Use dj_ui presentation (migration preview)"
    default n
    help
        Incremental package H migration. Overview, Library and Hot Cues use dj_ui
        presentation and existing transport/library state. Settings still
        use the qualified legacy presentation until their parity gates pass.
        This is a development preview, not hardware acceptance.
endmenu
```

## firmware/main-deck-p4/main/Kconfig.projbuild
```kconfig
menu "Pajoniiir migration options"

config PAJONIIIR_P4_LOCAL_CONTROLLER
    bool "Build experimental P4-local FLX4 controller path"
    default n
    help
        Compile the dual-controller USB Host owner, direct FLX4 USB-MIDI
        transport, local semantic runtime, local profile activation and direct
        MIDI LED feedback into the production ESP32-P4 firmware.

        This option is deliberately disabled in sdkconfig.defaults. The normal
        product image continues to use the proven ESP32-S3 control and cue-audio
        path until the physical dual-USB acceptance matrix passes. The enabled
        variant keeps the S3 UART transport alive as a fallback and for A/B
        validation.

endmenu
```

## firmware/p4-core/components/audio_engine/Kconfig
```kconfig
menu "Audio engine"
config AUDIO_ANTIALIAS_CACHE
    bool
    default y if PAJONIIIR_BOARD_M3
    default n


config AUDIO_SCRATCH_ENABLED
    bool "Enable vinyl/scratch mode (jog platter scratches the audio)"
    default n
    help
        When enabled, touching the FLX4 jog platter top while a deck plays
        scratches the audio (forward + reverse) by driving a read head over the
        per-deck PSRAM scratch capture buffer, instead of the Phase 1 platter
        hold+scrub. Releasing seeks normal forward playback to the head position.
        Additive: with this off the output path is unchanged and touching the
        platter does the Phase 1 hold/scrub. See docs/VINYL_SCRATCH_PLAN.md.

config AUDIO_PCM_TIMELINE_SCHEDULER_PROBE
    bool "Run one-shot PCM timeline scheduler probe"
    default n
    help
        Test-build-only probe. After audio initialization, run 100 forced
        low-word wrap and playhead handoff repetitions with a higher-priority
        same-core reader, then measure both unhooked publications for 100
        repetitions. The result is written as TIMELINE_SCHEDULER_PROBE in the
        service journal.
        This isolated scheduler probe must be paired with a live dual-deck
        audio smoke; it does not qualify the ae_output path by itself. Keep
        this disabled in production and release-candidate images.

endmenu
```

## firmware/p4-core/components/board_adapter/Kconfig
```kconfig
menu "Pajoniiir board"
choice PAJONIIIR_BOARD
    prompt "P4 board target"
    default PAJONIIIR_BOARD_JC4880
config PAJONIIIR_BOARD_JC4880
    bool "JC4880P443C_I_W target"
config PAJONIIIR_BOARD_JC1060
    bool "JC1060P470C_I_W_Y target"
config PAJONIIIR_BOARD_M3
    bool "JC-ESP32P4-M3-DEV target"
endchoice
config PAJONIIIR_DEFAULT_WIFI_REMOTE
    bool
    default y if PAJONIIIR_BOARD_M3
    default n
config PAJONIIIR_SD_INTERNAL_BOUNCE
    bool "Force microSD PSRAM buffers through internal DMA memory"
    default y if PAJONIIIR_BOARD_JC1060 && USB_HOST_DWC_DMA_CAP_MEMORY_IN_PSRAM
    default n
    help
        Use one persistent 8 KiB internal aligned buffer for all SD sector reads
        and writes. Required when testing JC1060 USB DMA in PSRAM; mount fails
        safely if this buffer cannot be allocated. JC4880 USB DMA policy stays
        internal. This does not change SD or media locking.
endmenu

menu "Pajoniiir JC4880 BSP"

config BSP_PCM5102A_MAIN_OUT
    bool "Enable PCM5102A main I2S output"
    default n
    help
        Enable the second I2S TX channel for the external PCM5102A MAIN OUT DAC.
        Keep disabled until GPIO50/GPIO52/GPIO51 are bench-verified on JP1.

config BSP_ES8311_MONITOR
    bool "Enable ES8311 onboard monitor codec"
    default y
    help
        Bring up the ES8311 codec on I2S unit 0 for the onboard monitor
        speaker/headphones path. Disable to free I2S unit 0 for the FLX4 USB
        headphones monitor link (product config: PCM5102A MAIN on unit 1 +
        monitor link on unit 0, cue/monitor delivered over USB to the FLX4).

endmenu
```

## firmware/p4-core/components/dj_link_service/Kconfig
```kconfig
menu "Pajoniiir network services"
config PAJONIIIR_DJ_LINK_SERVICE
    bool "Build experimental Pro DJ Link network library/cache/sync service"
    default y if PAJONIIIR_BOARD_JC1060
    default n
    help
        Uses only the explicitly supplied board network interface. JC1060
        retains its Ethernet provider. Other targets use a Wi-Fi STA provider
        for engineering experiments only. Runtime enable remains OFF by
        default; enabling this feature does not qualify any physical network.
endmenu
```
