## firmware/p4-core/components/library/Kconfig
```kconfig
menu "Media library"

config LIBRARY_ANLZ_CACHE_WRITE
    bool "Write parsed ANLZ metadata cache to microSD"
    default n
    help
        Cache cold USB ANLZ parses on microSD so later loads are faster. Disable
        this on hardware whose supply cannot tolerate the microSD commit current
        peak. Existing cache entries remain readable; only new writes are
        suppressed.

endmenu
```

## firmware/p4-core/components/ui/Kconfig
```kconfig
menu "Pajoniiir UI migration"
config PAJONIIIR_DJ_OVERVIEW
    bool "Use dj_ui presentation (migration preview)"
    depends on LV_USE_CUSTOM_MALLOC
    default n
    help
        Incremental package H migration. Overview, Library and Hot Cues use dj_ui
        presentation and existing transport/library state. Settings still
        use the qualified legacy presentation until their parity gates pass.
        This is a development preview, not hardware acceptance.
        All LVGL allocations use the custom PSRAM heap so small widgets and
        labels cannot consume internal memory needed by USB and Wi-Fi tasks.
endmenu
```

## firmware/p4-only-software-harness/sdkconfig.defaults
```kconfig
CONFIG_COMPILER_WARN_WRITE_STRINGS=y
CONFIG_COMPILER_OPTIMIZATION_ASSERTIONS_ENABLE=y
CONFIG_HAL_DEFAULT_ASSERTION_LEVEL=2
CONFIG_USB_HOST_CONTROL_TRANSFER_MAX_SIZE=512
CONFIG_ESP32P4_REV_MIN_FULL=100
CONFIG_ESP32P4_SELECTS_REV_LESS_V3=y
```
